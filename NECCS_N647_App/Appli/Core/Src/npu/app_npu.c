#include "app_npu.h"

#include "main.h"

#include "ll_aton_rt_user_api.h"
#include "ll_aton_NN_interface.h"
#include "npu_cache.h"
#include "network_weights_blob.h"

#include <string.h>

/* Generated by stedgeai (tools/npu): declares NN_Instance_network and the
 * buffer-info getters for the int8 sound classifier. */
LL_ATON_DECLARE_NAMED_NN_INSTANCE_AND_INTERFACE(network);

volatile uint32_t g_app_npu_test_request = 0U;
/* SWD-driven: freeze the live spectrum feed so g_app_npu_test_request runs
 * deterministic inferences without live traffic overwriting the IO buffers. */
volatile uint32_t g_app_npu_freeze_feed = 0U;

static AppNpuSnapshot_t s_npu;
static uint8_t s_runtime_ready = 0U;

static void AppNpu_EnableClocks(void)
{
  /* The NPU is a bus master: without RIMC attributes its AXI transactions
   * are issued non-secure and RISAF silently blocks every RAM access (reads
   * as zero, writes dropped) while register programming from the CPU still
   * works - the inference "completes" without touching memory
   * (board-verified 2026-07-12). Grant it the same secure/privileged CID1
   * profile the other masters (DCMIPP/DMA2D/LTDC/GPU2D) get in MX_RIF_Init. */
  {
    RIMC_MasterConfig_t rimc = {0};

    rimc.MasterCID = RIF_CID_1;
    rimc.SecPriv = RIF_ATTRIBUTE_SEC | RIF_ATTRIBUTE_PRIV;
    HAL_RIF_RIMC_ConfigMasterAttributes(RIF_MASTER_INDEX_NPU, &rimc);
    HAL_RIF_RISC_SetSlaveSecureAttributes(RIF_RISC_PERIPH_INDEX_NPU,
                                          RIF_ATTRIBUTE_SEC | RIF_ATTRIBUTE_PRIV);
  }

  /* NPU (ATON) bus+kernel clocks and the CACHEAXI (NPU cache) block.
   * CACHEAXI stays DISABLED (reset state = bypass): the network was compiled
   * with mpool cacheinfo bypass_enable=1, so the generated epochs contain no
   * NPU-cache maintenance. Enabling the cache leaves the final output write
   * stranded in CACHEAXI (board-verified 2026-07-12: CPU read stale input
   * bytes as logits until the cache was left in bypass). */
  __HAL_RCC_NPU_CLK_ENABLE();
  __HAL_RCC_NPU_FORCE_RESET();
  __HAL_RCC_NPU_RELEASE_RESET();
  npu_cache_enable_clocks_and_reset();

  /* The NPU-adjacent AXISRAM banks (0x34200000..0x343BFFFF) power up
   * disabled; the app image ends below 0x34200000, so nothing else turns
   * them on. Weights live in npuRAM5 and activations in npuRAM4. */
  __HAL_RCC_AXISRAM3_MEM_CLK_ENABLE();
  __HAL_RCC_AXISRAM4_MEM_CLK_ENABLE();
  __HAL_RCC_AXISRAM5_MEM_CLK_ENABLE();
  __HAL_RCC_AXISRAM6_MEM_CLK_ENABLE();

  /* Clock alone is not enough: these banks reset with RAMCFG SRAMSD
   * (shutdown) set, so reads return zeros and writes are dropped - the
   * CPU D-cache masks this, but the NPU sees dead RAM (board-verified
   * 2026-07-12: CR=0x00100000 on all four banks, all-zero inference IO).
   * Clear the shutdown bit and wait for the banks to come online. */
  __HAL_RCC_RAMCFG_CLK_ENABLE();
  {
    RAMCFG_TypeDef *const banks[4] = {
      RAMCFG_SRAM3_AXI, RAMCFG_SRAM4_AXI, RAMCFG_SRAM5_AXI, RAMCFG_SRAM6_AXI
    };

    for (uint32_t i = 0U; i < 4U; ++i)
    {
      banks[i]->CR &= ~RAMCFG_CR_SRAMSD;
    }
    for (uint32_t i = 0U; i < 4U; ++i)
    {
      uint32_t guard = 100000U;

      while (((banks[i]->ISR & RAMCFG_ISR_SRAMBUSY) != 0U) && (guard > 0U))
      {
        guard--;
      }
    }
  }
  __DSB();
}

static void AppNpu_EnsureDwt(void)
{
  CoreDebug->DEMCR |= CoreDebug_DEMCR_TRCENA_Msk;
  DWT->CTRL |= DWT_CTRL_CYCCNTENA_Msk;
}

int32_t AppNpu_Init(void)
{
  const LL_Buffer_InfoTypeDef *in_info;
  const LL_Buffer_InfoTypeDef *out_info;

  if (s_npu.initialized != 0U)
  {
    return 0;
  }

  AppNpu_EnableClocks();
  AppNpu_EnsureDwt();

  /* RAM-resident weights (debug profile): copy the blob into npuRAM5 and
   * verify the bank is actually alive before letting the NPU touch it. */
  memcpy((void *)(uintptr_t)NETWORK_WEIGHTS_BLOB_ADDR,
         g_network_weights_blob, NETWORK_WEIGHTS_BLOB_SIZE);
  SCB_CleanDCache_by_Addr((void *)(uintptr_t)NETWORK_WEIGHTS_BLOB_ADDR,
                          (int32_t)((NETWORK_WEIGHTS_BLOB_SIZE + 31U) & ~31U));
  __DSB();
  if (memcmp((const void *)(uintptr_t)NETWORK_WEIGHTS_BLOB_ADDR,
             g_network_weights_blob, 64U) != 0)
  {
    s_npu.last_status = 3U; /* npuRAM5 not accessible */
    return -1;
  }

  LL_ATON_RT_RuntimeInit();
  LL_ATON_RT_Init_Network(&NN_Instance_network);

  in_info = LL_ATON_Input_Buffers_Info_network();
  out_info = LL_ATON_Output_Buffers_Info_network();
  if ((in_info == NULL) || (out_info == NULL))
  {
    s_npu.last_status = 1U;
    return -1;
  }

  s_npu.in_addr = (uint32_t)(uintptr_t)LL_Buffer_addr_start(&in_info[0]);
  s_npu.in_bytes = LL_Buffer_len(&in_info[0]);
  s_npu.out_addr = (uint32_t)(uintptr_t)LL_Buffer_addr_start(&out_info[0]);
  s_npu.out_bytes = LL_Buffer_len(&out_info[0]);
  s_npu.initialized = 1U;
  s_npu.last_status = 0U;
  s_runtime_ready = 1U;
  return 0;
}

int32_t AppNpu_RunInference(const int8_t *spectrogram_2048)
{
  LL_ATON_RT_RetValues_t state;
  uint32_t start_cycles;
  int8_t *in;
  const int8_t *out;
  uint32_t guard = 0U;

  if (s_npu.initialized == 0U)
  {
    if (AppNpu_Init() != 0)
    {
      return -1;
    }
  }

  in = (int8_t *)(uintptr_t)s_npu.in_addr;
  if (spectrogram_2048 != NULL)
  {
    memcpy(in, spectrogram_2048, s_npu.in_bytes);
  }
  else
  {
    /* Synthetic ramp: deterministic non-trivial activation pattern. */
    for (uint32_t i = 0U; i < s_npu.in_bytes; ++i)
    {
      in[i] = (int8_t)((i * 7U) & 0x7FU) ;
    }
  }
  /* Input lives in NPU-visible RAM; flush CPU cache so the accelerator
   * sees it, then drop the output lines before reading results. */
  SCB_CleanDCache_by_Addr((void *)(uintptr_t)s_npu.in_addr, (int32_t)s_npu.in_bytes);
  __DSB();

  LL_ATON_RT_Reset_Network(&NN_Instance_network);

  start_cycles = DWT->CYCCNT;
  do
  {
    state = LL_ATON_RT_RunEpochBlock(&NN_Instance_network);
    guard++;
    if (guard > 2000000U)
    {
      s_npu.last_status = 2U; /* runaway */
      return -2;
    }
  } while (state != LL_ATON_RT_DONE);
  s_npu.last_cycles = DWT->CYCCNT - start_cycles;
  s_npu.last_us = (uint32_t)(((uint64_t)s_npu.last_cycles * 1000000ULL) / SystemCoreClock);

  SCB_InvalidateDCache_by_Addr((void *)(uintptr_t)s_npu.out_addr, (int32_t)((s_npu.out_bytes + 31U) & ~31U));
  __DSB();
  out = (const int8_t *)(uintptr_t)s_npu.out_addr;

  {
    int8_t best = out[0];
    uint8_t best_idx = 0U;

    for (uint32_t i = 0U; i < APP_NPU_CLASS_COUNT; ++i)
    {
      s_npu.output_q[i] = out[i];
      if (out[i] > best)
      {
        best = out[i];
        best_idx = (uint8_t)i;
      }
    }
    s_npu.top_class = best_idx;
  }

  s_npu.inference_count++;
  s_npu.last_status = 0U;
  return 0;
}

void AppNpu_GetSnapshot(AppNpuSnapshot_t *snapshot)
{
  if (snapshot != NULL)
  {
    *snapshot = s_npu;
  }
}

/* 32-frame rolling spectrum window, fed by the acoustic service thread. */
static int8_t s_spec_window[32U * 64U];
static uint32_t s_spec_head;
static uint32_t s_spec_feeds;

void AppNpu_FeedSpectrum(const uint8_t *spectrum_64)
{
  int8_t *row;

  if ((spectrum_64 == NULL) || (g_app_npu_freeze_feed != 0U))
  {
    return;
  }

  row = &s_spec_window[s_spec_head * 64U];
  for (uint32_t i = 0U; i < 64U; ++i)
  {
    /* uint8 0..255 -> int8 -128..127, matching the quantized input. */
    row[i] = (int8_t)((int32_t)spectrum_64[i] - 128);
  }
  s_spec_head = (s_spec_head + 1U) % 32U;
  s_spec_feeds++;

  /* Inference every 4 frames (~0.4 s at the ~10 Hz acoustic rate), and
   * only once the window has fully filled at least once. */
  if ((s_spec_feeds >= 32U) && ((s_spec_feeds & 3U) == 0U))
  {
    /* Assemble in time order: oldest row first. */
    static int8_t ordered[32U * 64U];

    for (uint32_t r = 0U; r < 32U; ++r)
    {
      const uint32_t src_row = (s_spec_head + r) % 32U;

      memcpy(&ordered[r * 64U], &s_spec_window[src_row * 64U], 64U);
    }
    (void)AppNpu_RunInference(ordered);
  }
}

void AppNpu_Poll(void)
{
  if (g_app_npu_test_request != 0U)
  {
    g_app_npu_test_request = 0U;
    (void)AppNpu_RunInference(NULL);
  }
}
